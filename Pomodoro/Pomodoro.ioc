# file: Pomodoro.ioc
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Mcu.Family=STM32F0
Mcu.Name=STM32F030C8Tx
Mcu.Package=LQFP48
NVIC.TIM14_IRQn=true\:0\:0\:false\:false\:true\:true\:true\:true
NVIC.TIM16_IRQn=true\:0\:0\:false\:false\:true\:true\:true\:true
ProjectManager.HeapSize=0x200
ProjectManager.StackSize=0x400
ProjectManager.TargetToolchain=STM32CubeIDE
RCC.APB1Freq_Value=8000000
RCC.APB1TimFreq_Value=8000000
TIM14.Period=60000
TIM14.Prescaler=4000
TIM16.Period=2000
TIM16.Prescaler=40000
VP_TIM14_VS_ClockSourceINT.Mode=Enable_Timer
VP_TIM16_VS_ClockSourceINT.Mode=Enable_Timer
board=custom

// file: Core/Src/main.c
/* USER CODE BEGIN Header */
/**
  ******************************************************************************
  * @file           : main.c
  * @brief          : Main program body
  ******************************************************************************
  * @attention
  *
  * Copyright (c) 2022 STMicroelectronics.
  * All rights reserved.
  *
  * This software is licensed under terms that can be found in the LICENSE file
  * in the root directory of this software component.
  * If no LICENSE file comes with this software, it is provided AS-IS.
  *
  ******************************************************************************
  */
/* USER CODE END Header */
#include "main.h"

/* USER CODE BEGIN Includes */
#include <stm32f030x8.h>
/* USER CODE END Includes */

TIM_HandleTypeDef htim14;
TIM_HandleTypeDef htim16;

void SystemClock_Config(void);
static void MX_TIM14_Init(void);
static void MX_TIM16_Init(void);
/* USER CODE BEGIN PFP */
void blink(int32_t);
/* USER CODE END PFP */

/* USER CODE BEGIN 0 */
int32_t timeLong = 0;
int32_t timeShort = 0;
/* USER CODE END 0 */

int main(void)
{
  /* USER CODE BEGIN 1 */
	GPIO_InitTypeDef LED1; // Set up Led as output (PF7)
	LED1.Pin =  GPIO_PIN_7;
	LED1.Mode = GPIO_MODE_OUTPUT_PP;
	LED1.Pull = GPIO_NOPULL;
	LED1.Speed = GPIO_SPEED_FREQ_LOW;

	__HAL_RCC_GPIOF_CLK_ENABLE();
	HAL_GPIO_Init(GPIOF, &LED1);
	/*
	GPIOF->MODER = 0x400;
	GPIOF->OTYPER = 0x80;
	GPIOF->OSPEEDR = 0x400;
	GPIOF->PUPDR = 0x0;

	GPIOF->ODR = 0x80; // write pin 7 high (bit 8)
	*/

	GPIO_InitTypeDef BUTTON;// Set up button as input (PA0)
	BUTTON.Pin = GPIO_PIN_0;
	BUTTON.Mode = GPIO_MODE_INPUT;
	BUTTON.Pull = GPIO_NOPULL;
	BUTTON.Speed = GPIO_SPEED_FREQ_LOW;

	__HAL_RCC_GPIOA_CLK_ENABLE();
	HAL_GPIO_Init(GPIOA, &BUTTON);

	_Bool brake = 0;
	int8_t pomodoros = 0;

  /* USER CODE END 1 */

  /* MCU Configuration--------------------------------------------------------*/

  /* Reset of all peripherals, Initializes the Flash interface and the Systick. */
  HAL_Init();

  /* Configure the system clock */
  SystemClock_Config();

  /* Initialize all configured peripherals */
  MX_TIM14_Init();
  MX_TIM16_Init();
  /* USER CODE BEGIN 2 */
  HAL_TIM_Base_Start_IT(&htim14);
  HAL_TIM_Base_Start_IT(&htim16);

  /* USER CODE END 2 */

  /* Infinite loop */
  /* USER CODE BEGIN WHILE */
  while (1)
  {

	  int buttonPressed = HAL_GPIO_ReadPin(GPIOA, GPIO_PIN_0);
	  if(buttonPressed){
		  // Turn led off and pause 2 minutes
		  int32_t tmp = timeLong;
		  while(timeLong - tmp < 5){
			  HAL_GPIO_WritePin(GPIOF, GPIO_PIN_7, GPIO_PIN_RESET);
		  }
		  timeLong = tmp;
	  }

	  if(brake == 0 && timeLong > 50){ // Work cycle 25 minutes (reality about 24)
		  brake = 1;
		  timeLong = 0;
		  pomodoros++;
	  }else if(brake == 1 && timeLong > 10 && pomodoros < 4){ // short brake 5 minutes
		  brake = 0;
		  timeLong = 0;
	  }else if(brake == 1 && timeLong > 30 && pomodoros >= 4){ // long brake 15 minutes
		  brake = 0;
		  timeLong = 0;
		  pomodoros = 0;
	  }

	  if(brake == 1 && pomodoros < 4){
		  // toggle led
		  blink(1); // non disruptive delay in seconds
	  }else if(brake == 1 && pomodoros >= 4){
		  blink(2);
	  }else{
		  // led On
		  HAL_GPIO_WritePin(GPIOF, GPIO_PIN_7, GPIO_PIN_SET);
	  }

    /* USER CODE END WHILE */

  }
}

void SystemClock_Config(void)
{
  RCC_OscInitTypeDef RCC_OscInitStruct = {0};
  RCC_ClkInitTypeDef RCC_ClkInitStruct = {0};

  /** Initializes the RCC Oscillators according to the specified parameters
  * in the RCC_OscInitTypeDef structure.
  */
  RCC_OscInitStruct.OscillatorType = RCC_OSCILLATORTYPE_HSI;
  RCC_OscInitStruct.HSIState = RCC_HSI_ON;
  RCC_OscInitStruct.HSICalibrationValue = RCC_HSICALIBRATION_DEFAULT;
  RCC_OscInitStruct.PLL.PLLState = RCC_PLL_NONE;
  if (HAL_RCC_OscConfig(&RCC_OscInitStruct) != HAL_OK)
  {
    Error_Handler();
  }

  /** Initializes the CPU, AHB and APB buses clocks
  */
  RCC_ClkInitStruct.ClockType = RCC_CLOCKTYPE_HCLK|RCC_CLOCKTYPE_SYSCLK
                              |RCC_CLOCKTYPE_PCLK1;
  RCC_ClkInitStruct.SYSCLKSource = RCC_SYSCLKSOURCE_HSI;
  RCC_ClkInitStruct.AHBCLKDivider = RCC_SYSCLK_DIV1;
  RCC_ClkInitStruct.APB1CLKDivider = RCC_HCLK_DIV1;

  if (HAL_RCC_ClockConfig(&RCC_ClkInitStruct, FLASH_LATENCY_0) != HAL_OK)
  {
    Error_Handler();
  }
}

static void MX_TIM14_Init(void)
{

  htim14.Instance = TIM14;
  htim14.Init.Prescaler = 4000;
  htim14.Init.CounterMode = TIM_COUNTERMODE_UP;
  htim14.Init.Period = 60000;
  htim14.Init.ClockDivision = TIM_CLOCKDIVISION_DIV1;
  htim14.Init.AutoReloadPreload = TIM_AUTORELOAD_PRELOAD_DISABLE;
  if (HAL_TIM_Base_Init(&htim14) != HAL_OK)
  {
    Error_Handler();
  }

}

static void MX_TIM16_Init(void)
{

  htim16.Instance = TIM16;
  htim16.Init.Prescaler = 4000;
  htim16.Init.CounterMode = TIM_COUNTERMODE_UP;
  htim16.Init.Period = 2000;
  htim16.Init.ClockDivision = TIM_CLOCKDIVISION_DIV1;
  htim16.Init.RepetitionCounter = 0;
  htim16.Init.AutoReloadPreload = TIM_AUTORELOAD_PRELOAD_DISABLE;
  if (HAL_TIM_Base_Init(&htim16) != HAL_OK)
  {
    Error_Handler();
  }

}

/* USER CODE BEGIN 4 */
void blink(int32_t seconds){
	if(timeShort > seconds){
		HAL_GPIO_TogglePin(GPIOF, GPIO_PIN_7);
		timeShort = 0;
	}
}

void HAL_TIM_PeriodElapsedCallback(TIM_HandleTypeDef* htim) // Gets called around every 30 seconds, 8MHz/40000(Prescaler) * 60 000 (Increments) = 30 seconds
{
	if(htim == &htim14){
		timeLong++;
	}else if(htim == &htim16){
		timeShort++;
	}
}
/* USER CODE END 4 */

void Error_Handler(void)
{
  __disable_irq();
  while (1)
  {
  }
}
